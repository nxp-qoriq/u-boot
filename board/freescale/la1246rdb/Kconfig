## board/freescale/la1246rdb/Kconfig
```kconfig
if TARGET_LA1246RDB

config SYS_BOARD
	default "la1246rdb"

config SYS_VENDOR
	default "freescale"

config SYS_SOC
	default "fsl-layerscape"

config SYS_CONFIG_NAME
	default "la1246rdb"

source "board/freescale/common/Kconfig"
endif
```

## board/freescale/ls1012afrdm/Kconfig
```kconfig
if TARGET_LS1012AFRDM

config SYS_BOARD
	default "ls1012afrdm"

config SYS_VENDOR
	default "freescale"

config SYS_SOC
	default "fsl-layerscape"

config SYS_CONFIG_NAME
	default "ls1012afrdm"

source "board/freescale/common/Kconfig"

endif

if TARGET_LS1012AFRWY

config SYS_BOARD
        default "ls1012afrdm"

config SYS_VENDOR
        default "freescale"

config SYS_SOC
        default "fsl-layerscape"

config SYS_CONFIG_NAME
        default "ls1012afrwy"

config SYS_LS_PPA_FW_ADDR
        hex "PPA Firmware Addr"
        default 0x40060000

config SYS_LS_PPA_ESBC_ADDR
	hex "PPA Firmware HDR Addr"
	default 0x401f4000

config SYS_LS_PFE_ESBC_ADDR
	hex "PFE Firmware HDR Addr"
	default 0x401f8000

source "board/freescale/common/Kconfig"

endif
```

## board/freescale/ls1046awrdb/Kconfig
```kconfig
if TARGET_LS1046AWRDB || TARGET_DB1046

config SYS_BOARD
	default "ls1046awrdb"

config SYS_VENDOR
	default "freescale"

config SYS_SOC
	default "fsl-layerscape"

config SYS_CONFIG_NAME
	default "ls1046awrdb"

source "board/freescale/common/Kconfig"
endif
```

## board/freescale/lx2160a/Kconfig
```kconfig
if TARGET_LX2160ARDB

config SYS_BOARD
	default "lx2160a"

config SYS_VENDOR
	default "freescale"

config SYS_SOC
	default "fsl-layerscape"

config SYS_CONFIG_NAME
	default "lx2160ardb"

source "board/freescale/common/Kconfig"
endif

if TARGET_LX2160AQDS

config SYS_BOARD
	default "lx2160a"

config SYS_VENDOR
	default "freescale"

config SYS_SOC
	default "fsl-layerscape"

config SYS_CONFIG_NAME
	default "lx2160aqds"

config SYS_LS_PPA_ESBC_ADDR
	hex "PPA Firmware HDR Addr"
	default 0x20680000

source "board/freescale/common/Kconfig"
endif
```

## board/freescale/lx2160abluebox3/Kconfig
```kconfig
if TARGET_LX2160ABLUEBOX3

config SYS_BOARD
        default "lx2160abluebox3"

config SYS_VENDOR
        default "freescale"

config SYS_SOC
        default "fsl-layerscape"

config SYS_CONFIG_NAME
        default "lx2160abluebox3"

source "board/freescale/common/Kconfig"
endif
```

## board/freescale/lx2160ahpcsom/Kconfig
```kconfig
if TARGET_LX2160AHPCSOM

config SYS_BOARD
        default "lx2160ahpcsom"

config SYS_VENDOR
        default "freescale"

config SYS_SOC
        default "fsl-layerscape"

config SYS_CONFIG_NAME
        default "lx2160ahpcsom"

source "board/freescale/common/Kconfig"
endif
```

## board/freescale/lx2160aqds_interposer/Kconfig
```kconfig
if TARGET_LX2160AQDS_INTERPOSER

config SYS_BOARD
	default "lx2160aqds_interposer"

config SYS_VENDOR
	default "freescale"

config SYS_SOC
	default "fsl-layerscape"

config SYS_CONFIG_NAME
	default "lx2160aqds_interposer"

endif
```

## board/freescale/lx2160ardb_interposer/Kconfig
```kconfig
if TARGET_LX2160ARDB_INTERPOSER

config SYS_BOARD
	default "lx2160ardb_interposer"

config SYS_VENDOR
	default "freescale"

config SYS_SOC
	default "fsl-layerscape"

config SYS_CONFIG_NAME
	default "lx2160ardb_interposer"

endif
```

## configs/la1224rdb_tfa_defconfig
```kconfig
CONFIG_ARM=y
CONFIG_SKIP_LOWLEVEL_INIT=y
CONFIG_ARM_SMCCC=y
CONFIG_GIC_V3_ITS=y
CONFIG_TARGET_LA1224RDB=y
CONFIG_TFABOOT=y
CONFIG_SYS_TEXT_BASE=0x82000000
CONFIG_SYS_MALLOC_LEN=0x202000
CONFIG_SYS_MALLOC_F_LEN=0x6000
CONFIG_NR_DRAM_BANKS=3
CONFIG_ENV_SIZE=0x2000
CONFIG_ENV_OFFSET=0x500000
CONFIG_ENV_SECT_SIZE=0x20000
CONFIG_DM_GPIO=y
CONFIG_DEFAULT_DEVICE_TREE="fsl-la1224-rdb"
CONFIG_FSL_USE_PCA9547_MUX=y
CONFIG_VID=y
CONFIG_SPL_VID=y
CONFIG_VID_FLS_ENV="la1224rdb_vdd_mv"
CONFIG_VOL_MONITOR_LTC3882_READ=y
CONFIG_VOL_MONITOR_LTC3882_SET=y
CONFIG_EMC2305=y
CONFIG_FSPI_AHB_EN_4BYTE=y
CONFIG_ARMV8_SEC_FIRMWARE_SUPPORT=y
CONFIG_SEC_FIRMWARE_ARMV8_PSCI=y
CONFIG_AHCI=y
CONFIG_OF_BOARD_FIXUP=y
CONFIG_REMAKE_ELF=y
CONFIG_MP=y
CONFIG_FIT_VERBOSE=y
CONFIG_OF_BOARD_SETUP=y
CONFIG_OF_STDOUT_VIA_ALIAS=y
CONFIG_DYNAMIC_SYS_CLK_FREQ=y
CONFIG_BOOTDELAY=10
CONFIG_USE_BOOTARGS=y
CONFIG_BOOTARGS="console=ttyAMA0,115200 root=/dev/ram0 earlycon=pl011,mmio32,0x21c0000 ramdisk_size=0x2000000 default_hugepagesz=1024m hugepagesz=1024m hugepages=2 pci=pcie_bus_perf pulse_width_1588=100"
CONFIG_MISC_INIT_R=y
CONFIG_CMD_GREPENV=y
CONFIG_ID_EEPROM=y
CONFIG_CMD_EEPROM=y
CONFIG_SYS_EEPROM_PAGE_WRITE_BITS=3
CONFIG_SYS_EEPROM_PAGE_WRITE_DELAY_MS=5
CONFIG_CMD_DM=y
CONFIG_CMD_GPIO=y
CONFIG_CMD_GPT=y
CONFIG_CMD_I2C=y
CONFIG_CMD_MMC=y
CONFIG_CMD_OPTEE_RPMB=y
CONFIG_CMD_PCI=y
CONFIG_CMD_USB=y
CONFIG_CMD_WDT=y
CONFIG_CMD_CACHE=y
CONFIG_OF_CONTROL=y
CONFIG_ENV_OVERWRITE=y
CONFIG_ENV_IS_IN_MMC=y
CONFIG_ENV_IS_IN_SPI_FLASH=y
CONFIG_ENV_ADDR=0x20500000
CONFIG_NET_RANDOM_ETHADDR=y
CONFIG_DM=y
CONFIG_SATA=y
CONFIG_SATA_CEVA=y
CONFIG_FSL_CAAM=y
CONFIG_DM_MMC=y
CONFIG_DYNAMIC_DDR_CLK_FREQ=y
CONFIG_DDR_ECC=y
CONFIG_ECC_INIT_VIA_DDRCONTROLLER=y
CONFIG_MPC8XXX_GPIO=y
CONFIG_DM_I2C=y
CONFIG_I2C_SET_DEFAULT_BUS_NUM=y
CONFIG_SYS_I2C_EEPROM_ADDR=0x57
CONFIG_SUPPORT_EMMC_RPMB=y
CONFIG_MMC_HS400_SUPPORT=y
CONFIG_FSL_ESDHC=y
CONFIG_MTD=y
CONFIG_DM_SPI_FLASH=y
CONFIG_SPI_FLASH_SPANSION=y
CONFIG_SPI_FLASH_STMICRO=y
CONFIG_SPI_FLASH_MT35XU=y
# CONFIG_SPI_FLASH_USE_4K_SECTORS is not set
CONFIG_PHYLIB=y
CONFIG_PHY_AQUANTIA=y
CONFIG_PHY_ATHEROS=y
CONFIG_PHY_INPHI=y
CONFIG_DM_ETH=y
CONFIG_DM_MDIO=y
CONFIG_E1000=y
CONFIG_MII=y
CONFIG_FSL_LS_MDIO=y
CONFIG_NVME_PCI=y
CONFIG_PCI=y
CONFIG_PCIE_LAYERSCAPE_RC=y
CONFIG_PCIE_LAYERSCAPE_GEN4=y
CONFIG_DM_RTC=y
CONFIG_RTC_PCF2127=y
CONFIG_DM_SCSI=y
CONFIG_DM_SERIAL=y
CONFIG_PL01X_SERIAL=y
CONFIG_SPI=y
CONFIG_DM_SPI=y
CONFIG_NXP_FSPI=y
CONFIG_TEE=y
CONFIG_OPTEE=y
CONFIG_USB=y
CONFIG_USB_XHCI_HCD=y
CONFIG_USB_XHCI_DWC3=y
CONFIG_WDT=y
CONFIG_WDT_SBSA=y
CONFIG_EFI_LOADER_BOUNCE_BUFFER=n
CONFIG_EFI_PARTITION=n
CONFIG_EFI_LOADER=n
CONFIG_CMD_BOOTEFI_BOOTMGR=n
CONFIG_EFI_VARIABLE_FILE_STORE=n
CONFIG_EFI_GET_TIME=n
CONFIG_EFI_DEVICE_PATH_TO_TEXT=n
CONFIG_EFI_DEVICE_PATH_UTIL=n
CONFIG_EFI_DT_FIXUP=n
CONFIG_EFI_LOADER_HII=n
CONFIG_EFI_UNICODE_COLLATION_PROTOCOL2=n
CONFIG_EFI_UNICODE_CAPITALIZATION=n
CONFIG_EFI_HAVE_RUNTIME_RESET=n
CONFIG_EFI_LOAD_FILE2_INITRD=n
```

## configs/ls1046atp1_tfa_defconfig
```kconfig
CONFIG_ARM=y
CONFIG_TARGET_LS1046ATP1=y
CONFIG_SYS_TEXT_BASE=0x82000000
CONFIG_ENV_SIZE=0x2000
CONFIG_ENV_SECT_SIZE=0x40000
CONFIG_ENV_OFFSET=0x500000
CONFIG_QSPI_AHB_INIT=y
CONFIG_ARMV8_SEC_FIRMWARE_SUPPORT=y
CONFIG_SEC_FIRMWARE_ARMV8_PSCI=y
CONFIG_AHCI=y
CONFIG_DISTRO_DEFAULTS=y
CONFIG_NR_DRAM_BANKS=2
CONFIG_FIT_VERBOSE=y
CONFIG_OF_BOARD_SETUP=y
CONFIG_BOOTDELAY=10
CONFIG_TFABOOT=y
CONFIG_USE_BOOTARGS=y
CONFIG_BOOTARGS="root=/dev/mmcblk0p3 ramdisk_size=0x30000000 console=ttyS0,115200 earlycon=uart8250,mmio,0x21c0500  rw rootdelay=10 default_hugepagesz=1024m hugepagesz=1024m hugepages=1 mem=6G"
CONFIG_MISC_INIT_R=y
CONFIG_CMD_GPT=y
CONFIG_CMD_I2C=y
CONFIG_CMD_MMC=y
CONFIG_CMD_PCI=y
CONFIG_CMD_USB=y
CONFIG_CMD_CACHE=y
#CONFIG_CMD_DATE=y
CONFIG_MP=y
CONFIG_MTDPARTS_DEFAULT="mtdparts=1550000.quadspi:1m(rcw),15m(u-boot),48m(kernel.itb);7e800000.flash:16m(nand_uboot),48m(nand_kernel),448m(nand_free)"
CONFIG_OF_CONTROL=y
CONFIG_DEFAULT_DEVICE_TREE="fsl-ls1046a-tp1"
CONFIG_ENV_IS_IN_MMC=y
CONFIG_ENV_IS_IN_SPI_FLASH=y
CONFIG_DM=y
CONFIG_SATA_CEVA=y
CONFIG_FSL_CAAM=y
CONFIG_DM_MMC=y
CONFIG_FSL_ESDHC=y
CONFIG_SPI_FLASH=y
CONFIG_SPI_FLASH_STMICRO=y
# CONFIG_SPI_FLASH_USE_4K_SECTORS is not set
# CONFIG_SPI_FLASH_BAR is not set
CONFIG_PHYLIB=y
CONFIG_PHY_AQUANTIA=y
CONFIG_FMAN_ENET=y
CONFIG_SYS_QE_FMAN_FW_IN_SPIFLASH=y
CONFIG_PHY_GIGE=y
CONFIG_PCI=y
CONFIG_DM_PCI=y
CONFIG_DM_PCI_COMPAT=y
CONFIG_PCIE_LAYERSCAPE=y
CONFIG_DM_SCSI=y
CONFIG_SYS_NS16550=y
CONFIG_SPI=y
CONFIG_DM_SPI=y
CONFIG_FSL_QSPI=y
CONFIG_USB=y
CONFIG_DM_USB=y
CONFIG_USB_XHCI_HCD=y
CONFIG_USB_XHCI_DWC3=y
CONFIG_USB_STORAGE=y
CONFIG_EFI_LOADER_BOUNCE_BUFFER=y
CONFIG_DM_GPIO=y
CONFIG_WDT=y
CONFIG_CMD_WDT=y
CONFIG_IMX_WATCHDOG=y
CONFIG_CMD_MMC_RPMB=y
CONFIG_SUPPORT_EMMC_RPMB=y
CONFIG_MTD_RAW_NAND=y
CONFIG_MTD=y
CONFIG_CMD_FLASH=y
CONFIG_ID_SPI_FLASH=y
CONFIG_PCI_BOOTDELAY=y
CONFIG_SYS_ID_OFFSET=y
CONFIG_POWER_LEGACY=y
CONFIG_CMD_NAND=y
CONFIG_FSL_USE_PCA9547_MUX=y
CONFIG_I2C_SET_DEFAULT_BUS_NUM=y
CONFIG_NAND_FSL_IFC=y
CONFIG_SYS_FMAN_FW_ADDR=0x900000
CONFIG_SYS_I2C_MXC_I2C1=y
CONFIG_SYS_I2C_MXC_I2C2=y
CONFIG_SYS_I2C_MXC_I2C3=y
CONFIG_SYS_I2C_MXC_I2C4=y
CONFIG_SYS_I2C_LEGACY=y
CONFIG_SYS_I2C_EARLY_INIT=y
CONFIG_ENV_OVERWRITE=y
```

## configs/lx2160apxp_peb_defconfig
```kconfig
CONFIG_ARM=y
CONFIG_TARGET_LX2160ARDB=y
CONFIG_SYS_PEB_BOOT=y
CONFIG_SYS_TEXT_BASE=0x20100000
CONFIG_DEFAULT_DEVICE_TREE="fsl-lx2160a-rdb"
CONFIG_DM=y
CONFIG_FIT=y
CONFIG_FIT_VERBOSE=y
CONFIG_OF_BOARD_SETUP=y
CONFIG_OF_STDOUT_VIA_ALIAS=y
CONFIG_BOOTDELAY=-1
CONFIG_USE_BOOTARGS=y
CONFIG_BOOTARGS="console=ttyS1,115200 root=/dev/ram0 earlycon=uart8250,mmio,0x21c0600 ramdisk_size=0x2000000 default_hugepagesz=2m hugepagesz=2m hugepages=256"
# CONFIG_CMD_IMLS is not set
CONFIG_CMD_GREPENV=y
CONFIG_CMD_GPT=y
CONFIG_CMD_CACHE=y
CONFIG_OF_CONTROL=y
CONFIG_DM_SERIAL=y
CONFIG_ARCH_LX2160A_EMU_COMMON=y
CONFIG_ENV_IS_NOWHERE=y
# CONFIG_SYS_FSL_DDR_PHY is not set
CONFIG_SYS_PHY_GEN2_DDR_PHY=y
CONFIG_SYS_MALLOC_F_LEN=0x5000
```

## configs/lx2160aqds_sdcard_defconfig
```kconfig
CONFIG_ARM=y
CONFIG_TARGET_LX2160AQDS=y
CONFIG_SPL=y
CONFIG_SPL_LIBCOMMON_SUPPORT=y
CONFIG_SPL_LIBGENERIC_SUPPORT=y
CONFIG_FSL_LS_PPA=y
CONFIG_SPL_MMC_SUPPORT=y
CONFIG_SYS_MMCSD_RAW_MODE_U_BOOT_USE_SECTOR=y
CONFIG_SYS_MMCSD_RAW_MODE_U_BOOT_SECTOR=0x900
CONFIG_SPL_SERIAL_SUPPORT=y
CONFIG_SPL_DRIVERS_MISC_SUPPORT=y
CONFIG_SPL_ENV_SUPPORT=y
CONFIG_SPL_I2C_SUPPORT=y
CONFIG_SD_BOOT=y
CONFIG_SPL_MPC8XXX_INIT_DDR_SUPPORT=y
CONFIG_DEFAULT_DEVICE_TREE="fsl-lx2160a-qds"
CONFIG_DM=y
CONFIG_OF_BOARD_SETUP=y
CONFIG_OF_STDOUT_VIA_ALIAS=y
CONFIG_BOOTDELAY=10
CONFIG_USE_BOOTARGS=y
CONFIG_BOOTARGS="console=ttyS1,115200 root=/dev/ram0 earlycon=uart8250,mmio,0x21c0600 ramdisk_size=0x2000000 default_hugepagesz=2m hugepagesz=2m hugepages=256 pci=pcie_bus_perf"
# CONFIG_CMD_IMLS is not set
CONFIG_CMD_GREPENV=y
CONFIG_CMD_EEPROM=y
CONFIG_CMD_GPT=y
CONFIG_CMD_I2C=y
CONFIG_CMD_MMC=y
CONFIG_CMD_PCI=y
CONFIG_CMD_SF=y
CONFIG_CMD_USB=y
CONFIG_CMD_CACHE=y
CONFIG_CMD_NET=y
CONFIG_CMD_PING=y
CONFIG_CMD_PXE=y
CONFIG_CMD_MII=y
CONFIG_CMD_DHCP=y
CONFIG_CMD_FAT=y
CONFIG_CMD_EXT2=y
CONFIG_NET=y
CONFIG_PCI=y
CONFIG_DM_PCI=y
CONFIG_DM_PCI_COMPAT=y
CONFIG_PCIE_LX=y
CONFIG_E1000=y
CONFIG_OF_CONTROL=y
CONFIG_ENV_IS_IN_MMC=y
CONFIG_NET_RANDOM_ETHADDR=y
CONFIG_DM_SERIAL=y
CONFIG_FSL_CAAM=y
CONFIG_DM_SPI=y
CONFIG_DM_SPI_FLASH=y
CONFIG_SPI_FLASH=y
CONFIG_SPI_FLASH_STMICRO=y
CONFIG_SPI_FLASH_USE_4K_SECTORS=n
CONFIG_NXP_FSPI=y
CONFIG_FSL_DSPI=y
CONFIG_SPI_FLASH_SPANSION=y
CONFIG_FSPI_AHB_EN_4BYTE=y
CONFIG_SYS_FSPI_AHB_INIT=y
CONFIG_PHYLIB=y
CONFIG_NETDEVICES=y
CONFIG_PHY_GIGE=y
CONFIG_BLK=n
CONFIG_USB=y
CONFIG_DM_USB=y
CONFIG_USB_XHCI_HCD=y
CONFIG_USB_XHCI_DWC3=y
CONFIG_USB_STORAGE=y
CONFIG_EFI_LOADER_BOUNCE_BUFFER=y
# CONFIG_SYS_FSL_DDR_PHY is not set
CONFIG_SYS_PHY_GEN2_DDR_PHY=y
CONFIG_SPL_FIT=y
CONFIG_SYS_MALLOC_F=y
CONFIG_SYS_MALLOC_F_LEN=0x6000
CONFIG_SPL_SYS_MALLOC_F_LEN=0x6000
CONFIG_PHYLIB_10G=y
CONFIG_PHY_AQUANTIA=y # X-M11-USXGMII
CONFIG_PHY_CORTINA=y # X-M7-40G
CONFIG_PHY_REALTEK=y # RGMII
CONFIG_PHY_INPHI=y # X-M8-100G
CONFIG_PHY_VITESSE=y # SGMII PEX RISER
CONFIG_HUSH_PARSER=y
```

## configs/lx2160ardb_peb_defconfig
```kconfig
CONFIG_ARM=y
CONFIG_TARGET_LX2160ARDB=y
CONFIG_SYS_PEB_BOOT=y
CONFIG_SYS_TEXT_BASE=0x20100000
CONFIG_DEFAULT_DEVICE_TREE="fsl-lx2160a-rdb"
CONFIG_DM=y
CONFIG_FIT=y
CONFIG_FIT_VERBOSE=y
CONFIG_OF_BOARD_SETUP=y
CONFIG_OF_STDOUT_VIA_ALIAS=y
CONFIG_BOOTDELAY=-1
CONFIG_USE_BOOTARGS=y
CONFIG_BOOTARGS="console=ttyS1,115200 root=/dev/ram0 earlycon=uart8250,mmio,0x21c0600 ramdisk_size=0x2000000 default_hugepagesz=2m hugepagesz=2m hugepages=256"
# CONFIG_CMD_IMLS is not set
# CONFIG_CMD_GREPENV is not set
CONFIG_CMD_EEPROM=y
CONFIG_CMD_GPT=y
CONFIG_CMD_I2C=y
# CONFIG_CMD_MMC is not set
CONFIG_CMD_PCI=y
CONFIG_CMD_SF=y
CONFIG_CMD_USB=y
CONFIG_CMD_CACHE=y
CONFIG_CMD_NET=y
CONFIG_CMD_PING=y
CONFIG_NET=y
# CONFIG_PCI is not set
# CONFIG_DM_PCI is not set
# CONFIG_DM_PCI_COMPAT is not set
# CONFIG_PCIE_LX is not set
# CONFIG_E1000 is not set
CONFIG_OF_CONTROL=y
CONFIG_ENV_IS_IN_SPI_FLASH=y
CONFIG_NET_RANDOM_ETHADDR=y
CONFIG_DM_SERIAL=y
# CONFIG_FSL_CAAM is not set
CONFIG_DM_SPI=y
CONFIG_DM_SPI_FLASH=y
CONFIG_SPI_FLASH=y
CONFIG_SPI_FLASH_STMICRO=y
CONFIG_SPI_FLASH_SPANSION=y
CONFIG_SPI_FLASH_USE_4K_SECTORS=n
CONFIG_NXP_FSPI=y
CONFIG_PHYLIB=y
CONFIG_NETDEVICES=y
CONFIG_PHY_GIGE=y
# CONFIG_DM_MMC is not set
# CONFIG_DM_MMC_OPS is not set
CONFIG_BLK=n
CONFIG_USB=y
CONFIG_DM_USB=y
CONFIG_USB_XHCI_HCD=y
CONFIG_USB_XHCI_DWC3=y
CONFIG_USB_STORAGE=y
# CONFIG_EFI_LOADER_BOUNCE_BUFFER is not set
```

## configs/lx2160ardb_sdcard_defconfig
```kconfig
CONFIG_ARM=y
CONFIG_TARGET_LX2160ARDB=y
CONFIG_SPL=y
CONFIG_SPL_LIBCOMMON_SUPPORT=y
CONFIG_SPL_LIBGENERIC_SUPPORT=y
CONFIG_FSL_LS_PPA=y
CONFIG_SPL_MMC_SUPPORT=y
CONFIG_SYS_MMCSD_RAW_MODE_U_BOOT_USE_SECTOR=y
CONFIG_SYS_MMCSD_RAW_MODE_U_BOOT_SECTOR=0x900
CONFIG_SPL_SERIAL_SUPPORT=y
CONFIG_SPL_DRIVERS_MISC_SUPPORT=y
CONFIG_SPL_ENV_SUPPORT=y
CONFIG_SPL_I2C_SUPPORT=y
CONFIG_SD_BOOT=y
CONFIG_SPL_MPC8XXX_INIT_DDR_SUPPORT=y
CONFIG_DEFAULT_DEVICE_TREE="fsl-lx2160a-rdb"
CONFIG_DM=y
CONFIG_OF_BOARD_SETUP=y
CONFIG_OF_STDOUT_VIA_ALIAS=y
CONFIG_BOOTDELAY=10
CONFIG_USE_BOOTARGS=y
CONFIG_BOOTARGS="console=ttyS1,115200 root=/dev/ram0 earlycon=uart8250,mmio,0x21c0600 ramdisk_size=0x2000000 default_hugepagesz=2m hugepagesz=2m hugepages=256 pci=pcie_bus_perf"
# CONFIG_CMD_IMLS is not set
CONFIG_CMD_GREPENV=y
CONFIG_CMD_EEPROM=y
CONFIG_CMD_GPT=y
CONFIG_CMD_I2C=y
CONFIG_CMD_MMC=y
CONFIG_CMD_PCI=y
CONFIG_CMD_SF=y
CONFIG_CMD_USB=y
CONFIG_CMD_DHCP=y
CONFIG_CMD_MII=y
CONFIG_CMD_PING=y
CONFIG_CMD_CACHE=y
CONFIG_CMD_NET=y
CONFIG_CMD_PXE=y
CONFIG_CMD_EXT2=y
CONFIG_CMD_FAT=y
# CONFIG_SPL_EFI_PARTITION is not set
CONFIG_FSL_CAAM=y
CONFIG_PCI=y
CONFIG_DM_PCI=y
CONFIG_DM_PCI_COMPAT=y
CONFIG_PCIE_LX=y
CONFIG_E1000=y
CONFIG_OF_CONTROL=y
CONFIG_NET_RANDOM_ETHADDR=y
CONFIG_DM_SERIAL=y
CONFIG_DM_SPI=y
CONFIG_DM_SPI_FLASH=y
CONFIG_SPI_FLASH=y
CONFIG_SPI_FLASH_STMICRO=y
CONFIG_SPI_FLASH_USE_4K_SECTORS=n
CONFIG_SPI_FLASH_SPANSION=y
CONFIG_NXP_FSPI=y
CONFIG_FSPI_AHB_EN_4BYTE=y
CONFIG_SYS_FSPI_AHB_INIT=y
CONFIG_PHYLIB=y
CONFIG_NETDEVICES=y
CONFIG_NET=y
CONFIG_PHY_GIGE=y
CONFIG_BLK=n
CONFIG_USB=y
CONFIG_DM_USB=y
CONFIG_USB_XHCI_HCD=y
CONFIG_USB_XHCI_DWC3=y
CONFIG_USB_STORAGE=y
CONFIG_EFI_LOADER_BOUNCE_BUFFER=y
CONFIG_SCSI_AHCI=y
CONFIG_SCSI=y
# CONFIG_SYS_FSL_DDR_PHY is not set
CONFIG_SYS_GEN2_DDR_PHY=y
CONFIG_SPL_FIT=y
CONFIG_SYS_MALLOC_F=y
CONFIG_SYS_MALLOC_F_LEN=0x6000
CONFIG_SPL_SYS_MALLOC_F_LEN=0x6000
CONFIG_PHYLIB_10G=y
CONFIG_PHY_AQUANTIA=y
CONFIG_PHY_CORTINA=y
CONFIG_PHY_ATHEROS=y
CONFIG_PHY_INPHI=y
CONFIG_INPHI_25G=y
CONFIG_HUSH_PARSER=y
CONFIG_EMC2305=y
```

## configs/lx2160asimu_defconfig
```kconfig
CONFIG_ARCH_LX2160A_SIMU=y
CONFIG_PCI=n
CONFIG_DM_PCI=n
CONFIG_DM_PCI_COMPAT=n
CONFIG_PCIE_LX=n
CONFIG_E1000=n
```

## drivers/net/pfe_eth/Kconfig
```kconfig
menuconfig FSL_PFE
	bool "Freescale PFE driver"
	help
	  This driver provides support for Freescale PFE.

if FSL_PFE

config UTIL_PE_DISABLED
	bool
	help
	  Disable UTIL processor engine of PFE

config SYS_FSL_PFE_ADDR
	hex "PFE base address"
	default 0x04000000

config SYS_LS_PFE_FW_ADDR
	hex "Flash address of PFE firmware"
	default 0x40a00000

config DDR_PFE_PHYS_BASEADDR
	hex "PFE DDR physical base address"
	default 0x03800000

config DDR_PFE_BASEADDR
	hex "PFE DDR base address"
	default 0x83800000

endif
```

## drivers/qe/Kconfig
```kconfig
#
# QUICC Engine Drivers
#
config  U_QE
	bool "Enable support for U QUICC Engine"
	default y if ARCH_LS1021A && !SD_BOOT && !NAND_BOOT && !QSPI_BOOT
	help
	  Choose this option to add support for U QUICC Engine.
```
