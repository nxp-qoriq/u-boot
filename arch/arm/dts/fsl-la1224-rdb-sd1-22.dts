// SPDX-License-Identifier: GPL-2.0+ OR X11
/*
 * NXP LA1224RDB device tree source for SerDes#1 protocol 22
 *
 * Copyright 2025 NXP
 *
 */

/dts-v1/;

#include "fsl-la1224-rdb.dtsi"

/ {
	model = "NXP Layerscape LA1224-RDB Board - SerDes#1 22";
	compatible = "nxp,la1224rdb", "fsl,lx2160a";

	aliases {
		spi0 = &fspi;
	};
};

&dpmac5 {
	status = "okay";
	phy-connection-type = "10gbase-r";
};
