/*
 * Device Tree file for Freescale Layerscape-1028A family SoC.
 *
 * Copyright 2018 NXP
 *
 * SPDX-License-Identifier:	GPL-2.0+	X11
 */

/dts-v1/;
#include "fsl-ls1028a-qds.dtsi"

/ {
	chosen {
		stdout-path = &lpuart0;
	};
};
