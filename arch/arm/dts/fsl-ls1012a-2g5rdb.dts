/*
 * NXP ls1012a 2G5RDB board device tree source
 *
 * Copyright 2017 NXP
 *
 * SPDX-License-Identifier:	GPL-2.0+
 */

/dts-v1/;
#include "fsl-ls1012a-rdb.dtsi"

/ {
       chosen {
               stdout-path = &duart0;
       };
};
